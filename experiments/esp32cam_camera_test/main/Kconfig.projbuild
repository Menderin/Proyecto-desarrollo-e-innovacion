## experiments/esp32cam_camera_test/main/Kconfig.projbuild
```kconfig
menu "Nodo ESP32-CAM"

    config CAMERA_TELEGRAM_ENABLED
        bool "Habilitar envio de alertas a Telegram"
        default n

    config CAMERA_WIFI_SSID
        string "Nombre de la red Wi-Fi"
        default ""
        depends on CAMERA_TELEGRAM_ENABLED

    config CAMERA_WIFI_PASSWORD
        string "Contrasena de la red Wi-Fi"
        default ""
        depends on CAMERA_TELEGRAM_ENABLED

    config CAMERA_TELEGRAM_BOT_TOKEN
        string "Token del bot de Telegram"
        default ""
        depends on CAMERA_TELEGRAM_ENABLED

    config CAMERA_TELEGRAM_CHAT_ID
        string "Chat ID del grupo de Telegram"
        default ""
        depends on CAMERA_TELEGRAM_ENABLED

    config CAMERA_TELEGRAM_QUEUE_LENGTH
        int "Alertas que pueden esperar envio"
        range 1 4
        default 2
        depends on CAMERA_TELEGRAM_ENABLED

    config CAMERA_TELEGRAM_RETRIES
        int "Intentos de envio por alerta"
        range 1 5
        default 3
        depends on CAMERA_TELEGRAM_ENABLED

    config CAMERA_TELEGRAM_TEST_ON_BOOT
        bool "Enviar foto de prueba a Telegram al arrancar"
        default n
        depends on CAMERA_TELEGRAM_ENABLED

endmenu
```

## experiments/esp32cam_camera_test/sdkconfig.defaults
```kconfig
CONFIG_IDF_TARGET="esp32"
CONFIG_ESPTOOLPY_FLASHSIZE_4MB=y
CONFIG_ESPTOOLPY_FLASHSIZE="4MB"
CONFIG_PARTITION_TABLE_CUSTOM=y
CONFIG_PARTITION_TABLE_CUSTOM_FILENAME="partitions.csv"
CONFIG_SPIRAM=y
CONFIG_SPIRAM_BOOT_INIT=y
CONFIG_SPIRAM_USE_MALLOC=y
CONFIG_SPIRAM_MALLOC_ALWAYSINTERNAL=16384
CONFIG_SPIRAM_MALLOC_RESERVE_INTERNAL=32768
CONFIG_ESP_MAIN_TASK_STACK_SIZE=8192
CONFIG_MBEDTLS_CERTIFICATE_BUNDLE=y
CONFIG_MBEDTLS_CERTIFICATE_BUNDLE_DEFAULT_CMN=y
```

## sdkconfig.defaults
```kconfig
# sdkconfig.defaults — Pórtico de Clasificación Magnética
# Target: ESP32 estándar (no S3, no C3)
CONFIG_IDF_TARGET="esp32"

# FreeRTOS: 1kHz tick para mayor resolución en vTaskDelay
CONFIG_FREERTOS_HZ=1000

# Log level por defecto: INFO
CONFIG_LOG_DEFAULT_LEVEL_INFO=y

# Desactivar el watchdog del loop idle (evita resets en tareas largas)
CONFIG_ESP_TASK_WDT_EN=y
CONFIG_ESP_TASK_WDT_INIT=y
CONFIG_ESP_TASK_WDT_TIMEOUT_S=10

# Stack mínimo para tareas de app
CONFIG_ESP_MAIN_TASK_STACK_SIZE=8192
```
